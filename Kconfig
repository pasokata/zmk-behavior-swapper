## Kconfig
```kconfig
DT_COMPAT_ZMK_BEHAVIOR_SWAPPER := zmk,behavior_swapper

config ZMK_BEHAVIOR_SWAPPER
    bool
    default $(dt_compat_enabled,$(DT_COMPAT_ZMK_BEHAVIOR_SWAPPER))
```

## dts/bindings/behaviors/zmk,behavior-swapper.yaml
```yaml
# Copyright (c) 2025 The ZMK Contributors
# SPDX-License-Identifier: MIT

description: Swapper behavior

compatible: "zmk,behavior-swapper"

include: two_param.yaml

properties:
  bindings:
    type: phandles
    required: true
  release-after-ms:
    type: int
    required: true
```
